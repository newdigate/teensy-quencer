#include <iostream>
#include <SD.h>
#include <dirent.h>
#include "sequencer.h"
#include "midireader.h"
#include "midisequenceadapter.h"
#include <cstdio>
#include <pwd.h>
#include <unistd.h>
#include <math.h>

using namespace std;
using namespace newdigate;

void first_test();
void second_test();
void midisequenceadapter_test();

extern unsigned char innuendo_mid[];
extern unsigned int innuendo_mid_len;

streampos readFileData(const string& filename, char *&buffer);
void polyphonicsampler_test();
const char *getHomeDirectory();

int main(int argc, char **argv){
    std::cout << "starting app...\n";
    initialize_mock_arduino();
    //polyphonicsampler_test();
    midisequenceadapter_test();
    first_test();

    std::cout << "complete...\n";
}
long polyphony = 0;

void midisequenceadapter_test() {
    char *buffer = (char *)&innuendo_mid[0];
    SD.setSDCardFileData(buffer, innuendo_mid_len);

    tempo tempo;
    multisequencer multisequencer(tempo);
    sequencer *sequencer1 = multisequencer.newSequencer();
    sequencer *sequencer2 = multisequencer.newSequencer();
    sequencer *sequencer3 = multisequencer.newSequencer();
    sequencer *sequencer4 = multisequencer.newSequencer();

    midisequenceadapter adapter(multisequencer);
    adapter.loadMidi("blah.mid");
    pattern* pat = adapter.loadMidifileToChannelNumber(0, 4, 420);

    sequencer1->writenoteslist(0);
}

void first_test() {
    tempo tempo(120.0f);
    songposition *position = new songposition();
    sequencer sequencer(tempo, position);
    sequencer.onevent = [&] (sequencerevent *event) {
        Serial.printf("%d:%d:%4f\n", position->bar, position->beat, position->sixtyFourth / 64.0f);
        Serial.printf("----- %d:%d:%d\n", event->channel, event->isNoteStartEvent, event->noteNumber);
    };

    sequencer.addPattern(4);

    /*
    for (int i=0; i < 16; i++) {
      loopelement *kick = new loopelement();
      kick->rate = 1.0f;
      kick->start_tick = ;
      kick->stop_tick = (i * 480) + 479;
      kick->channel = 2;
      kick->loopType = looptypex_none;
      sequencer.addelement(0, kick, (i * 480), 479, 2, 1.0);
  }

  for (int i=0; i < 16; i++) {
      loopelement *kick = new loopelement();
      kick->rate = 1.0f;
      kick->start_tick = ((i+2) * 480);
      kick->stop_tick = ((i+2) * 480) + 479;
      kick->channel = 3;
      kick->loopType = looptypex_none;
      sequencer.addelement(0, kick);
  }

  for (int i=0; i < 32; i++) {
      loopelement *snare = new loopelement();
      snare->rate = 1.0f;
      snare->start_tick = ((i+2) * 240);
      snare->stop_tick = ((i+2) * 240) + 239;
      snare->channel = 1;
      snare->loopType = looptypex_none;
      sequencer.addelement(0, snare);
  }
     */

 //   sequencer.writescore(0);
    sequencer.writenoteslist(0);
  //return;
    sequencer.start(micros());
   // sequencer.tick(0);
   // sequencer.tick(250);
  //  sequencer.tick(500);
  //  sequencer.tick(750);
  //  sequencer.tick(1000);
  //  sequencer.tick(1250);
  //  sequencer.tick(1500);
/*
    while (true) {
       sequencer.tick(micros());
       //Serial.printf("%d:%d:%4f\n", position.bar, position.beat, position.sixtyFourth / 64.0f);
       delay(5);
    }
    for (int i=0; i<8; i++) {
       sequencer.tick(micros());
       delay(20);
    }
*/
 }

void second_test() {
    tempo tempo(120.0f);

    multisequencer multisequencer(tempo);

    sequencer *sequencer = multisequencer.newSequencer();
    
    sequencer->onevent = [&] (sequencerevent *event) {
        //Serial.printf("%d:%d:%4f\n", position.bar, position.beat, position.sixtyFourth / 64.0f);
        Serial.printf("----- %d:%d:%4f\n", event->channel, event->isNoteStartEvent, event->noteNumber);
    };

    sequencer->addPattern(4);

    /*
    for (int i=0; i < 16; i++) {
      loopelement *kick = new loopelement();
      kick->rate = 1.0f;
      kick->start_tick = (i * 480);
      kick->stop_tick = (i * 480) + 479;
      kick->channel = 2;
      kick->loopType = looptypex_none;
      sequencer->addelement(0, kick);
  }

  for (int i=0; i < 16; i++) {
      loopelement *kick = new loopelement();
      kick->rate = 1.0f;
      kick->start_tick = ((i+2) *480);
      kick->stop_tick = ((i+2) * 480) + 479;
      kick->channel = 3;
      kick->loopType = looptypex_none;
      sequencer->addelement(0, kick);
  }

  for (int i=0; i < 32; i++) {
      loopelement *snare = new loopelement();
      snare->rate = 1.0f;
      snare->start_tick = ((i+2) * 240);
      snare->stop_tick = ((i+2) * 240) + 239;
      snare->channel = 1;
      snare->loopType = looptypex_none;
      sequencer->addelement(0, snare);
  }
     */

    //sequencer->writescore(0);
    sequencer->writenoteslist(0);

  //return;
    multisequencer.start(micros());
   // sequencer.tick(0);
   // sequencer.tick(250);
  //  sequencer.tick(500);
  //  sequencer.tick(750);
  //  sequencer.tick(1000);
  //  sequencer.tick(1250);
  //  sequencer.tick(1500);

    while (true) {
       multisequencer.tick(micros());
       //Serial.printf("%d:%d:%4f\n", position.bar, position.beat, position.sixtyFourth / 64.0f);
       delay(5);
    }
}

void search(const std::string& curr_directory, const std::string& extension, vector<string> &results){
	DIR* dir_point = opendir(curr_directory.c_str());
    if (!dir_point) {
        cout << "Directory not found!!! " << curr_directory << "\n";
        return;
    }
	dirent* entry = readdir(dir_point);
	while (entry){									// if !entry then end of directory
		if (entry->d_type == DT_DIR){				// if entry is a directory
			std::string fname = entry->d_name;
			if (fname != "." && fname != "..")
				search(entry->d_name, extension, results);	// search through it
		}
		else if (entry->d_type == DT_REG){		// if entry is a regular file
			std::string fname = entry->d_name;	// filename
      // if filename's last characters are extension
			if (fname.find(extension, (fname.length() - extension.length())) != std::string::npos)
				results.push_back(fname);		// add filename to results vector
		}
		entry = readdir(dir_point);
	}
	return;
}

const char *getHomeDirectory() {
    const char *homeDir = getenv("HOME");
    if (!homeDir) {
        struct passwd* pwd = getpwuid(getuid());
        if (pwd)
           homeDir = pwd->pw_dir;
    }
    printf("Home directory is %s\n", homeDir);
    return homeDir;
}

streampos readFileData(const string& filename, char *&buffer) {
    fstream mockFile = fstream();
    mockFile.open(filename, ios_base::in | ios_base::binary | ios_base::ate);
    if (mockFile.is_open()) {
        streampos bytesRead = mockFile.tellg();
        buffer = new char[bytesRead];
        mockFile.seekg(0, ios_base::beg);
        mockFile.read(buffer, bytesRead);
        mockFile.close();
        return bytesRead;
    }
    return 0;
}

void millis_test() {
  unsigned long start = millis();
  cout << "millis() test start: " << start << endl;
  while( millis() - start < 10000 ) {
	cout << millis() << endl;
	delay(1);
  }
  unsigned long end = millis();
  cout << "End of test - duration: " << end - start << "ms" << endl;
}

void delay_test() {
  unsigned long start = millis();
  cout << "delay() test start: " << start << endl;
  while( millis() - start < 10000 ) {
	cout << millis() << endl;
	delay(250);
  }
  unsigned long end = millis();
  cout << "End of test - duration: " << end - start << "ms" << endl;
}

unsigned char innuendo_mid[] = {
        0x4d, 0x54, 0x68, 0x64, 0x00, 0x00, 0x00, 0x06, 0x00, 0x01, 0x00, 0x05,
        0x01, 0xe0, 0x4d, 0x54, 0x72, 0x6b, 0x00, 0x00, 0x02, 0xaa, 0x00, 0xff,
        0x58, 0x04, 0x04, 0x02, 0x18, 0x08, 0x00, 0xff, 0x59, 0x02, 0x00, 0x00,
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        0x50, 0x89, 0x30, 0xff, 0x2f, 0x00
};
unsigned int innuendo_mid_len = 13854;